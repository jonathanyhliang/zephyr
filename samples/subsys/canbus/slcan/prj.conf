## CMakeLists.txt
```
# SPDX-License-Identifier: Apache-2.0

cmake_minimum_required(VERSION 3.20.0)


find_package(Zephyr REQUIRED HINTS $ENV{ZEPHYR_BASE})
project(SLCAN)

target_sources(app PRIVATE src/main.c)
```

## prj.conf
```kconfig
CONFIG_SLCAN=y
CONFIG_SLCAN_LOOPBACK_MODE=y
CONFIG_CAN_INIT_PRIORITY=80
CONFIG_CAN_MAX_FILTER=5

CONFIG_CONSOLE_SUBSYS=y
CONFIG_CONSOLE_GETCHAR=y

CONFIG_BOOTLOADER_MCUBOOT=y
CONFIG_REBOOT=y
```

## src/main.c
```c
#include <stdio.h>
#include <zephyr/kernel.h>
#include <zephyr/console/console.h>
#include <zephyr/canbus/slcan.h>

void main(void)
{
    int ret;
    char *s;

    ret = slcan_init();
    if (ret < 0) {
        return;
    }

    ret = console_init();
	if (ret < 0) {
		return;
	}

    while (1) {
        s = slcan_getline((char)console_getchar());
        if (s) {
            (void)slcan_decaps(s);
        }
    }
}
```
