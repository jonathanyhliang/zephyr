## drivers/flash/Kconfig.cc32xx
```kconfig
# SPDX-License-Identifier: Apache-2.0

config SOC_FLASH_CC32XX
	bool "TI SimpleLink CC32XX flash controller driver"
	default y
	depends on DT_HAS_TI_CC32XX_FLASH_CONTROLLER_ENABLED
	select FLASH_HAS_PAGE_LAYOUT
	select FLASH_HAS_DRIVER_ENABLED
	select MPU_ALLOW_FLASH_WRITE if ARM_MPU
	help
	  Enables TI SimpleLink CC32XX flash controller driver.
```

## dts/bindings/flash_controller/ti,cc32xx-flash-controller.yaml
```yaml
description: Texas Instruments CC32xx flash controller

compatible: "ti,cc32xx-flash-controller"

include: flash-controller.yaml
```

## subsys/canbus/slcan/Kconfig
```kconfig
# SLCAN configuration options

# SPDX-License-Identifier: Apache-2.0

menuconfig SLCAN
	bool "Serial-Line CAN"
	select CAN
	select POLL
	help
	  Enable Serial-Line CAN sub sub-system.

if SLCAN

module = SLCAN
module-str = SLCAN
source "subsys/logging/Kconfig.template.log_config"

config SLCAN_LOOPBACK_MODE
	bool "Serial-Line CAN Loopback mode"
	default n
	help
	  Set the controller to loopback mode.
	  This allows testing without a second board.

endif # SLCAN
	  
```
